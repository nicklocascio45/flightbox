## esp32/components/mqtt_wrapper/Kconfig
```kconfig
menu "MQTT Configuration"

    config MQTT_BROKER_HOSTNAME
        string "MQTT Broker Hostname"
        default "127.0.0.1"
        help
            The hostname or IP address to connect to.

    config MQTT_USERNAME
        string "MQTT Username"
        default "username"

    config MQTT_PASSWORD
        string "MQTT Password"
        default "password"

endmenu
```

## esp32/components/wifi_sta/Kconfig
```kconfig
menu "WiFi STA Configuration"

    config WIFI_STA_CONNECT
        bool "Connect using WiFi"
        default n
        help
            Enables the WiFi driver to connect to local network.
    
    if WIFI_STA_CONNECT
        config WIFI_STA_SSID
            string "WiFi SSID"
            default "myssid"
            help
                Network name (SSID) to connect to.

        config WIFI_STA_PASSWORD
            string "WiFi Password"
            default "mypassword"

    endif

endmenu
```
